## CMakeLists.txt
```
cmake_minimum_required(VERSION 3.20)
find_package(Zephyr REQUIRED HINTS $ENV{ZEPHYR_BASE})
project(hello_world)
add_executable(app src/main.c)
target_link_libraries(app PRIVATE zephyr_interface)
```

## west.yml
```
manifest:
  version: "0.13"

  remotes:
    - name: zephyr
      url-base: https://github.com/zephyrproject-rtos

  projects:
    - name: zephyr
      remote: zephyr
      revision: main
      import: true  # Import Zephyr's west.yml for additional modules

  self:
    path: app  # This is the application (manifest repository)
```

## prj.conf
```kconfig
CONFIG_PRINTK=y
CONFIG_STDOUT_CONSOLE=y
```

## src/main.c
```c
#include <zephyr/kernel.h>
#include <zephyr/sys/printk.h>

void main(void)
{
    printk("Hello World from Zephyr!\n");
    while (1) {
        k_msleep(1000);
        printk("Running...\n");
    }
}
```
